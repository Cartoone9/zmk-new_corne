## config/west.yml
```yaml
manifest:
  remotes:
    - name: zmkfirmware
      url-base: https://github.com/zmkfirmware
  projects:
    - name: eyelash_corne
      url: https://github.com/a741725193/zmk-new_corne
      revision: main
    - name: zmk
      remote: zmkfirmware
      revision: main
      import: app/west.yml
    - name: zmk-rgb
      remote: zmkfirmware
      revision: main
      import: rgb/west.yml
    - name: zmk-behaviors
      remote: zmkfirmware
      revision: main
      import: behaviors/west.yml
  self:
    path: config
```
